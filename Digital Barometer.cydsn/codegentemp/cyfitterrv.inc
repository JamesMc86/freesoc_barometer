    IF :LNOT::DEF:INCLUDED_CYFITTERRV_INC
INCLUDED_CYFITTERRV_INC EQU 1
    GET cydevicerv.inc
    GET cydevicerv_trm.inc

; I2C_bI2C_UDB
I2C_bI2C_UDB_Master_ClkGen_u0__A0_A1_REG EQU CYREG_B0_UDB15_A0_A1
I2C_bI2C_UDB_Master_ClkGen_u0__A0_REG EQU CYREG_B0_UDB15_A0
I2C_bI2C_UDB_Master_ClkGen_u0__A1_REG EQU CYREG_B0_UDB15_A1
I2C_bI2C_UDB_Master_ClkGen_u0__D0_D1_REG EQU CYREG_B0_UDB15_D0_D1
I2C_bI2C_UDB_Master_ClkGen_u0__D0_REG EQU CYREG_B0_UDB15_D0
I2C_bI2C_UDB_Master_ClkGen_u0__D1_REG EQU CYREG_B0_UDB15_D1
I2C_bI2C_UDB_Master_ClkGen_u0__DP_AUX_CTL_REG EQU CYREG_B0_UDB15_ACTL
I2C_bI2C_UDB_Master_ClkGen_u0__F0_F1_REG EQU CYREG_B0_UDB15_F0_F1
I2C_bI2C_UDB_Master_ClkGen_u0__F0_REG EQU CYREG_B0_UDB15_F0
I2C_bI2C_UDB_Master_ClkGen_u0__F1_REG EQU CYREG_B0_UDB15_F1
I2C_bI2C_UDB_Shifter_u0__16BIT_A0_REG EQU CYREG_B0_UDB12_13_A0
I2C_bI2C_UDB_Shifter_u0__16BIT_A1_REG EQU CYREG_B0_UDB12_13_A1
I2C_bI2C_UDB_Shifter_u0__16BIT_D0_REG EQU CYREG_B0_UDB12_13_D0
I2C_bI2C_UDB_Shifter_u0__16BIT_D1_REG EQU CYREG_B0_UDB12_13_D1
I2C_bI2C_UDB_Shifter_u0__16BIT_DP_AUX_CTL_REG EQU CYREG_B0_UDB12_13_ACTL
I2C_bI2C_UDB_Shifter_u0__16BIT_F0_REG EQU CYREG_B0_UDB12_13_F0
I2C_bI2C_UDB_Shifter_u0__16BIT_F1_REG EQU CYREG_B0_UDB12_13_F1
I2C_bI2C_UDB_Shifter_u0__A0_A1_REG EQU CYREG_B0_UDB12_A0_A1
I2C_bI2C_UDB_Shifter_u0__A0_REG EQU CYREG_B0_UDB12_A0
I2C_bI2C_UDB_Shifter_u0__A1_REG EQU CYREG_B0_UDB12_A1
I2C_bI2C_UDB_Shifter_u0__D0_D1_REG EQU CYREG_B0_UDB12_D0_D1
I2C_bI2C_UDB_Shifter_u0__D0_REG EQU CYREG_B0_UDB12_D0
I2C_bI2C_UDB_Shifter_u0__D1_REG EQU CYREG_B0_UDB12_D1
I2C_bI2C_UDB_Shifter_u0__DP_AUX_CTL_REG EQU CYREG_B0_UDB12_ACTL
I2C_bI2C_UDB_Shifter_u0__F0_F1_REG EQU CYREG_B0_UDB12_F0_F1
I2C_bI2C_UDB_Shifter_u0__F0_REG EQU CYREG_B0_UDB12_F0
I2C_bI2C_UDB_Shifter_u0__F1_REG EQU CYREG_B0_UDB12_F1
I2C_bI2C_UDB_StsReg__0__MASK EQU 0x01
I2C_bI2C_UDB_StsReg__0__POS EQU 0
I2C_bI2C_UDB_StsReg__16BIT_STATUS_AUX_CTL_REG EQU CYREG_B0_UDB11_12_ACTL
I2C_bI2C_UDB_StsReg__16BIT_STATUS_REG EQU CYREG_B0_UDB11_12_ST
I2C_bI2C_UDB_StsReg__1__MASK EQU 0x02
I2C_bI2C_UDB_StsReg__1__POS EQU 1
I2C_bI2C_UDB_StsReg__2__MASK EQU 0x04
I2C_bI2C_UDB_StsReg__2__POS EQU 2
I2C_bI2C_UDB_StsReg__3__MASK EQU 0x08
I2C_bI2C_UDB_StsReg__3__POS EQU 3
I2C_bI2C_UDB_StsReg__4__MASK EQU 0x10
I2C_bI2C_UDB_StsReg__4__POS EQU 4
I2C_bI2C_UDB_StsReg__5__MASK EQU 0x20
I2C_bI2C_UDB_StsReg__5__POS EQU 5
I2C_bI2C_UDB_StsReg__MASK EQU 0x3F
I2C_bI2C_UDB_StsReg__MASK_REG EQU CYREG_B0_UDB11_MSK
I2C_bI2C_UDB_StsReg__MASK_ST_AUX_CTL_REG EQU CYREG_B0_UDB11_MSK_ACTL
I2C_bI2C_UDB_StsReg__PER_ST_AUX_CTL_REG EQU CYREG_B0_UDB11_MSK_ACTL
I2C_bI2C_UDB_StsReg__STATUS_AUX_CTL_REG EQU CYREG_B0_UDB11_ACTL
I2C_bI2C_UDB_StsReg__STATUS_CNT_REG EQU CYREG_B0_UDB11_ST_CTL
I2C_bI2C_UDB_StsReg__STATUS_CONTROL_REG EQU CYREG_B0_UDB11_ST_CTL
I2C_bI2C_UDB_StsReg__STATUS_REG EQU CYREG_B0_UDB11_ST
I2C_bI2C_UDB_SyncCtl_CtrlReg__16BIT_CONTROL_AUX_CTL_REG EQU CYREG_B0_UDB11_12_ACTL
I2C_bI2C_UDB_SyncCtl_CtrlReg__16BIT_CONTROL_CONTROL_REG EQU CYREG_B0_UDB11_12_CTL
I2C_bI2C_UDB_SyncCtl_CtrlReg__16BIT_CONTROL_COUNT_REG EQU CYREG_B0_UDB11_12_CTL
I2C_bI2C_UDB_SyncCtl_CtrlReg__16BIT_COUNT_CONTROL_REG EQU CYREG_B0_UDB11_12_CTL
I2C_bI2C_UDB_SyncCtl_CtrlReg__16BIT_COUNT_COUNT_REG EQU CYREG_B0_UDB11_12_CTL
I2C_bI2C_UDB_SyncCtl_CtrlReg__16BIT_MASK_MASK_REG EQU CYREG_B0_UDB11_12_MSK
I2C_bI2C_UDB_SyncCtl_CtrlReg__16BIT_MASK_PERIOD_REG EQU CYREG_B0_UDB11_12_MSK
I2C_bI2C_UDB_SyncCtl_CtrlReg__16BIT_PERIOD_MASK_REG EQU CYREG_B0_UDB11_12_MSK
I2C_bI2C_UDB_SyncCtl_CtrlReg__16BIT_PERIOD_PERIOD_REG EQU CYREG_B0_UDB11_12_MSK
I2C_bI2C_UDB_SyncCtl_CtrlReg__1__MASK EQU 0x02
I2C_bI2C_UDB_SyncCtl_CtrlReg__1__POS EQU 1
I2C_bI2C_UDB_SyncCtl_CtrlReg__2__MASK EQU 0x04
I2C_bI2C_UDB_SyncCtl_CtrlReg__2__POS EQU 2
I2C_bI2C_UDB_SyncCtl_CtrlReg__4__MASK EQU 0x10
I2C_bI2C_UDB_SyncCtl_CtrlReg__4__POS EQU 4
I2C_bI2C_UDB_SyncCtl_CtrlReg__5__MASK EQU 0x20
I2C_bI2C_UDB_SyncCtl_CtrlReg__5__POS EQU 5
I2C_bI2C_UDB_SyncCtl_CtrlReg__6__MASK EQU 0x40
I2C_bI2C_UDB_SyncCtl_CtrlReg__6__POS EQU 6
I2C_bI2C_UDB_SyncCtl_CtrlReg__7__MASK EQU 0x80
I2C_bI2C_UDB_SyncCtl_CtrlReg__7__POS EQU 7
I2C_bI2C_UDB_SyncCtl_CtrlReg__CONTROL_AUX_CTL_REG EQU CYREG_B0_UDB11_ACTL
I2C_bI2C_UDB_SyncCtl_CtrlReg__CONTROL_REG EQU CYREG_B0_UDB11_CTL
I2C_bI2C_UDB_SyncCtl_CtrlReg__CONTROL_ST_REG EQU CYREG_B0_UDB11_ST_CTL
I2C_bI2C_UDB_SyncCtl_CtrlReg__COUNT_REG EQU CYREG_B0_UDB11_CTL
I2C_bI2C_UDB_SyncCtl_CtrlReg__COUNT_ST_REG EQU CYREG_B0_UDB11_ST_CTL
I2C_bI2C_UDB_SyncCtl_CtrlReg__MASK EQU 0xF6
I2C_bI2C_UDB_SyncCtl_CtrlReg__MASK_CTL_AUX_CTL_REG EQU CYREG_B0_UDB11_MSK_ACTL
I2C_bI2C_UDB_SyncCtl_CtrlReg__PERIOD_REG EQU CYREG_B0_UDB11_MSK
I2C_bI2C_UDB_SyncCtl_CtrlReg__PER_CTL_AUX_CTL_REG EQU CYREG_B0_UDB11_MSK_ACTL

; I2C_IntClock
I2C_IntClock__CFG0 EQU CYREG_CLKDIST_DCFG0_CFG0
I2C_IntClock__CFG1 EQU CYREG_CLKDIST_DCFG0_CFG1
I2C_IntClock__CFG2 EQU CYREG_CLKDIST_DCFG0_CFG2
I2C_IntClock__CFG2_SRC_SEL_MASK EQU 0x07
I2C_IntClock__INDEX EQU 0x00
I2C_IntClock__PM_ACT_CFG EQU CYREG_PM_ACT_CFG2
I2C_IntClock__PM_ACT_MSK EQU 0x01
I2C_IntClock__PM_STBY_CFG EQU CYREG_PM_STBY_CFG2
I2C_IntClock__PM_STBY_MSK EQU 0x01

; I2C_I2C_IRQ
I2C_I2C_IRQ__INTC_CLR_EN_REG EQU CYREG_NVIC_CLRENA0
I2C_I2C_IRQ__INTC_CLR_PD_REG EQU CYREG_NVIC_CLRPEND0
I2C_I2C_IRQ__INTC_MASK EQU 0x01
I2C_I2C_IRQ__INTC_NUMBER EQU 0
I2C_I2C_IRQ__INTC_PRIOR_NUM EQU 7
I2C_I2C_IRQ__INTC_PRIOR_REG EQU CYREG_NVIC_PRI_0
I2C_I2C_IRQ__INTC_SET_EN_REG EQU CYREG_NVIC_SETENA0
I2C_I2C_IRQ__INTC_SET_PD_REG EQU CYREG_NVIC_SETPEND0

; LED_Out
LED_Out_Sync_ctrl_reg__0__MASK EQU 0x01
LED_Out_Sync_ctrl_reg__0__POS EQU 0
LED_Out_Sync_ctrl_reg__16BIT_CONTROL_AUX_CTL_REG EQU CYREG_B0_UDB10_11_ACTL
LED_Out_Sync_ctrl_reg__16BIT_CONTROL_CONTROL_REG EQU CYREG_B0_UDB10_11_CTL
LED_Out_Sync_ctrl_reg__16BIT_CONTROL_COUNT_REG EQU CYREG_B0_UDB10_11_CTL
LED_Out_Sync_ctrl_reg__16BIT_COUNT_CONTROL_REG EQU CYREG_B0_UDB10_11_CTL
LED_Out_Sync_ctrl_reg__16BIT_COUNT_COUNT_REG EQU CYREG_B0_UDB10_11_CTL
LED_Out_Sync_ctrl_reg__16BIT_MASK_MASK_REG EQU CYREG_B0_UDB10_11_MSK
LED_Out_Sync_ctrl_reg__16BIT_MASK_PERIOD_REG EQU CYREG_B0_UDB10_11_MSK
LED_Out_Sync_ctrl_reg__16BIT_PERIOD_MASK_REG EQU CYREG_B0_UDB10_11_MSK
LED_Out_Sync_ctrl_reg__16BIT_PERIOD_PERIOD_REG EQU CYREG_B0_UDB10_11_MSK
LED_Out_Sync_ctrl_reg__1__MASK EQU 0x02
LED_Out_Sync_ctrl_reg__1__POS EQU 1
LED_Out_Sync_ctrl_reg__CONTROL_AUX_CTL_REG EQU CYREG_B0_UDB10_ACTL
LED_Out_Sync_ctrl_reg__CONTROL_REG EQU CYREG_B0_UDB10_CTL
LED_Out_Sync_ctrl_reg__CONTROL_ST_REG EQU CYREG_B0_UDB10_ST_CTL
LED_Out_Sync_ctrl_reg__COUNT_REG EQU CYREG_B0_UDB10_CTL
LED_Out_Sync_ctrl_reg__COUNT_ST_REG EQU CYREG_B0_UDB10_ST_CTL
LED_Out_Sync_ctrl_reg__MASK EQU 0x03
LED_Out_Sync_ctrl_reg__MASK_CTL_AUX_CTL_REG EQU CYREG_B0_UDB10_MSK_ACTL
LED_Out_Sync_ctrl_reg__PERIOD_REG EQU CYREG_B0_UDB10_MSK
LED_Out_Sync_ctrl_reg__PER_CTL_AUX_CTL_REG EQU CYREG_B0_UDB10_MSK_ACTL

; LED_1
LED_1__0__MASK EQU 0x20
LED_1__0__PC EQU CYREG_IO_PC_PRT15_PC5
LED_1__0__PORT EQU 15
LED_1__0__SHIFT EQU 5
LED_1__AG EQU CYREG_PRT15_AG
LED_1__AMUX EQU CYREG_PRT15_AMUX
LED_1__BIE EQU CYREG_PRT15_BIE
LED_1__BIT_MASK EQU CYREG_PRT15_BIT_MASK
LED_1__BYP EQU CYREG_PRT15_BYP
LED_1__CTL EQU CYREG_PRT15_CTL
LED_1__DM0 EQU CYREG_PRT15_DM0
LED_1__DM1 EQU CYREG_PRT15_DM1
LED_1__DM2 EQU CYREG_PRT15_DM2
LED_1__DR EQU CYREG_PRT15_DR
LED_1__INP_DIS EQU CYREG_PRT15_INP_DIS
LED_1__LCD_COM_SEG EQU CYREG_PRT15_LCD_COM_SEG
LED_1__LCD_EN EQU CYREG_PRT15_LCD_EN
LED_1__MASK EQU 0x20
LED_1__PORT EQU 15
LED_1__PRT EQU CYREG_PRT15_PRT
LED_1__PRTDSI__CAPS_SEL EQU CYREG_PRT15_CAPS_SEL
LED_1__PRTDSI__DBL_SYNC_IN EQU CYREG_PRT15_DBL_SYNC_IN
LED_1__PRTDSI__OE_SEL0 EQU CYREG_PRT15_OE_SEL0
LED_1__PRTDSI__OE_SEL1 EQU CYREG_PRT15_OE_SEL1
LED_1__PRTDSI__OUT_SEL0 EQU CYREG_PRT15_OUT_SEL0
LED_1__PRTDSI__OUT_SEL1 EQU CYREG_PRT15_OUT_SEL1
LED_1__PRTDSI__SYNC_OUT EQU CYREG_PRT15_SYNC_OUT
LED_1__PS EQU CYREG_PRT15_PS
LED_1__SHIFT EQU 5
LED_1__SLW EQU CYREG_PRT15_SLW

; LED_2
LED_2__0__MASK EQU 0x10
LED_2__0__PC EQU CYREG_IO_PC_PRT15_PC4
LED_2__0__PORT EQU 15
LED_2__0__SHIFT EQU 4
LED_2__AG EQU CYREG_PRT15_AG
LED_2__AMUX EQU CYREG_PRT15_AMUX
LED_2__BIE EQU CYREG_PRT15_BIE
LED_2__BIT_MASK EQU CYREG_PRT15_BIT_MASK
LED_2__BYP EQU CYREG_PRT15_BYP
LED_2__CTL EQU CYREG_PRT15_CTL
LED_2__DM0 EQU CYREG_PRT15_DM0
LED_2__DM1 EQU CYREG_PRT15_DM1
LED_2__DM2 EQU CYREG_PRT15_DM2
LED_2__DR EQU CYREG_PRT15_DR
LED_2__INP_DIS EQU CYREG_PRT15_INP_DIS
LED_2__LCD_COM_SEG EQU CYREG_PRT15_LCD_COM_SEG
LED_2__LCD_EN EQU CYREG_PRT15_LCD_EN
LED_2__MASK EQU 0x10
LED_2__PORT EQU 15
LED_2__PRT EQU CYREG_PRT15_PRT
LED_2__PRTDSI__CAPS_SEL EQU CYREG_PRT15_CAPS_SEL
LED_2__PRTDSI__DBL_SYNC_IN EQU CYREG_PRT15_DBL_SYNC_IN
LED_2__PRTDSI__OE_SEL0 EQU CYREG_PRT15_OE_SEL0
LED_2__PRTDSI__OE_SEL1 EQU CYREG_PRT15_OE_SEL1
LED_2__PRTDSI__OUT_SEL0 EQU CYREG_PRT15_OUT_SEL0
LED_2__PRTDSI__OUT_SEL1 EQU CYREG_PRT15_OUT_SEL1
LED_2__PRTDSI__SYNC_OUT EQU CYREG_PRT15_SYNC_OUT
LED_2__PS EQU CYREG_PRT15_PS
LED_2__SHIFT EQU 4
LED_2__SLW EQU CYREG_PRT15_SLW

; SCL
SCL__0__MASK EQU 0x01
SCL__0__PC EQU CYREG_PRT6_PC0
SCL__0__PORT EQU 6
SCL__0__SHIFT EQU 0
SCL__AG EQU CYREG_PRT6_AG
SCL__AMUX EQU CYREG_PRT6_AMUX
SCL__BIE EQU CYREG_PRT6_BIE
SCL__BIT_MASK EQU CYREG_PRT6_BIT_MASK
SCL__BYP EQU CYREG_PRT6_BYP
SCL__CTL EQU CYREG_PRT6_CTL
SCL__DM0 EQU CYREG_PRT6_DM0
SCL__DM1 EQU CYREG_PRT6_DM1
SCL__DM2 EQU CYREG_PRT6_DM2
SCL__DR EQU CYREG_PRT6_DR
SCL__INP_DIS EQU CYREG_PRT6_INP_DIS
SCL__LCD_COM_SEG EQU CYREG_PRT6_LCD_COM_SEG
SCL__LCD_EN EQU CYREG_PRT6_LCD_EN
SCL__MASK EQU 0x01
SCL__PORT EQU 6
SCL__PRT EQU CYREG_PRT6_PRT
SCL__PRTDSI__CAPS_SEL EQU CYREG_PRT6_CAPS_SEL
SCL__PRTDSI__DBL_SYNC_IN EQU CYREG_PRT6_DBL_SYNC_IN
SCL__PRTDSI__OE_SEL0 EQU CYREG_PRT6_OE_SEL0
SCL__PRTDSI__OE_SEL1 EQU CYREG_PRT6_OE_SEL1
SCL__PRTDSI__OUT_SEL0 EQU CYREG_PRT6_OUT_SEL0
SCL__PRTDSI__OUT_SEL1 EQU CYREG_PRT6_OUT_SEL1
SCL__PRTDSI__SYNC_OUT EQU CYREG_PRT6_SYNC_OUT
SCL__PS EQU CYREG_PRT6_PS
SCL__SHIFT EQU 0
SCL__SLW EQU CYREG_PRT6_SLW

; SDA
SDA__0__MASK EQU 0x02
SDA__0__PC EQU CYREG_PRT6_PC1
SDA__0__PORT EQU 6
SDA__0__SHIFT EQU 1
SDA__AG EQU CYREG_PRT6_AG
SDA__AMUX EQU CYREG_PRT6_AMUX
SDA__BIE EQU CYREG_PRT6_BIE
SDA__BIT_MASK EQU CYREG_PRT6_BIT_MASK
SDA__BYP EQU CYREG_PRT6_BYP
SDA__CTL EQU CYREG_PRT6_CTL
SDA__DM0 EQU CYREG_PRT6_DM0
SDA__DM1 EQU CYREG_PRT6_DM1
SDA__DM2 EQU CYREG_PRT6_DM2
SDA__DR EQU CYREG_PRT6_DR
SDA__INP_DIS EQU CYREG_PRT6_INP_DIS
SDA__LCD_COM_SEG EQU CYREG_PRT6_LCD_COM_SEG
SDA__LCD_EN EQU CYREG_PRT6_LCD_EN
SDA__MASK EQU 0x02
SDA__PORT EQU 6
SDA__PRT EQU CYREG_PRT6_PRT
SDA__PRTDSI__CAPS_SEL EQU CYREG_PRT6_CAPS_SEL
SDA__PRTDSI__DBL_SYNC_IN EQU CYREG_PRT6_DBL_SYNC_IN
SDA__PRTDSI__OE_SEL0 EQU CYREG_PRT6_OE_SEL0
SDA__PRTDSI__OE_SEL1 EQU CYREG_PRT6_OE_SEL1
SDA__PRTDSI__OUT_SEL0 EQU CYREG_PRT6_OUT_SEL0
SDA__PRTDSI__OUT_SEL1 EQU CYREG_PRT6_OUT_SEL1
SDA__PRTDSI__SYNC_OUT EQU CYREG_PRT6_SYNC_OUT
SDA__PS EQU CYREG_PRT6_PS
SDA__SHIFT EQU 1
SDA__SLW EQU CYREG_PRT6_SLW

; Miscellaneous
; -- WARNING: define names containing LEOPARD or PANTHER are deprecated and will be removed in a future release
CYDEV_DEBUGGING_DPS_SWD_SWV EQU 6
CYDEV_CONFIG_UNUSED_IO_AllowButWarn EQU 0
CYDEV_CONFIGURATION_MODE_COMPRESSED EQU 0
CYDEV_CONFIG_FASTBOOT_ENABLED EQU 1
CYDEV_CHIP_REV_PSOC5LP_PRODUCTION EQU 0
CYDEV_CHIP_REVISION_5B_PRODUCTION EQU 0
CYDEV_CHIP_MEMBER_5B EQU 4
CYDEV_CHIP_FAMILY_PSOC5 EQU 3
CYDEV_CHIP_DIE_PSOC5LP EQU 4
CYDEV_CHIP_DIE_EXPECT EQU CYDEV_CHIP_DIE_PSOC5LP
BCLK__BUS_CLK__HZ EQU 24000000
BCLK__BUS_CLK__KHZ EQU 24000
BCLK__BUS_CLK__MHZ EQU 24
CYDEV_CHIP_DIE_ACTUAL EQU CYDEV_CHIP_DIE_EXPECT
CYDEV_CHIP_DIE_LEOPARD EQU 1
CYDEV_CHIP_DIE_PANTHER EQU 3
CYDEV_CHIP_DIE_PSOC4A EQU 2
CYDEV_CHIP_DIE_UNKNOWN EQU 0
CYDEV_CHIP_FAMILY_PSOC3 EQU 1
CYDEV_CHIP_FAMILY_PSOC4 EQU 2
CYDEV_CHIP_FAMILY_UNKNOWN EQU 0
CYDEV_CHIP_FAMILY_USED EQU CYDEV_CHIP_FAMILY_PSOC5
CYDEV_CHIP_JTAG_ID EQU 0x2E123069
CYDEV_CHIP_MEMBER_3A EQU 1
CYDEV_CHIP_MEMBER_4A EQU 2
CYDEV_CHIP_MEMBER_5A EQU 3
CYDEV_CHIP_MEMBER_UNKNOWN EQU 0
CYDEV_CHIP_MEMBER_USED EQU CYDEV_CHIP_MEMBER_5B
CYDEV_CHIP_REVISION_3A_ES1 EQU 0
CYDEV_CHIP_REVISION_3A_ES2 EQU 1
CYDEV_CHIP_REVISION_3A_ES3 EQU 3
CYDEV_CHIP_REVISION_3A_PRODUCTION EQU 3
CYDEV_CHIP_REVISION_4A_ES0 EQU 17
CYDEV_CHIP_REVISION_4A_PRODUCTION EQU 17
CYDEV_CHIP_REVISION_5A_ES0 EQU 0
CYDEV_CHIP_REVISION_5A_ES1 EQU 1
CYDEV_CHIP_REVISION_5A_PRODUCTION EQU 1
CYDEV_CHIP_REVISION_5B_ES0 EQU 0
CYDEV_CHIP_REVISION_USED EQU CYDEV_CHIP_REVISION_5B_PRODUCTION
CYDEV_CHIP_REV_EXPECT EQU CYDEV_CHIP_REV_PSOC5LP_PRODUCTION
CYDEV_CHIP_REV_LEOPARD_ES1 EQU 0
CYDEV_CHIP_REV_LEOPARD_ES2 EQU 1
CYDEV_CHIP_REV_LEOPARD_ES3 EQU 3
CYDEV_CHIP_REV_LEOPARD_PRODUCTION EQU 3
CYDEV_CHIP_REV_PANTHER_ES0 EQU 0
CYDEV_CHIP_REV_PANTHER_ES1 EQU 1
CYDEV_CHIP_REV_PANTHER_PRODUCTION EQU 1
CYDEV_CHIP_REV_PSOC4A_ES0 EQU 17
CYDEV_CHIP_REV_PSOC4A_PRODUCTION EQU 17
CYDEV_CHIP_REV_PSOC5LP_ES0 EQU 0
CYDEV_CONFIGURATION_COMPRESSED EQU 1
CYDEV_CONFIGURATION_DMA EQU 0
CYDEV_CONFIGURATION_ECC EQU 1
CYDEV_CONFIGURATION_IMOENABLED EQU CYDEV_CONFIG_FASTBOOT_ENABLED
CYDEV_CONFIGURATION_MODE EQU CYDEV_CONFIGURATION_MODE_COMPRESSED
CYDEV_CONFIGURATION_MODE_DMA EQU 2
CYDEV_CONFIGURATION_MODE_UNCOMPRESSED EQU 1
CYDEV_CONFIG_UNUSED_IO EQU CYDEV_CONFIG_UNUSED_IO_AllowButWarn
CYDEV_CONFIG_UNUSED_IO_AllowWithInfo EQU 1
CYDEV_CONFIG_UNUSED_IO_Disallowed EQU 2
CYDEV_DEBUGGING_DPS EQU CYDEV_DEBUGGING_DPS_SWD_SWV
CYDEV_DEBUGGING_DPS_Disable EQU 3
CYDEV_DEBUGGING_DPS_JTAG_4 EQU 1
CYDEV_DEBUGGING_DPS_JTAG_5 EQU 0
CYDEV_DEBUGGING_DPS_SWD EQU 2
CYDEV_DEBUGGING_ENABLE EQU 1
CYDEV_DEBUGGING_REQXRES EQU 1
CYDEV_DEBUGGING_XRES EQU 0
CYDEV_DEBUG_ENABLE_MASK EQU 0x20
CYDEV_DEBUG_ENABLE_REGISTER EQU CYREG_MLOGIC_DEBUG
CYDEV_DMA_CHANNELS_AVAILABLE EQU 24
CYDEV_ECC_ENABLE EQU 0
CYDEV_HEAP_SIZE EQU 0x1000
CYDEV_INSTRUCT_CACHE_ENABLED EQU 1
CYDEV_INTR_RISING EQU 0x00000001
CYDEV_PROJ_TYPE EQU 0
CYDEV_PROJ_TYPE_BOOTLOADER EQU 1
CYDEV_PROJ_TYPE_LOADABLE EQU 2
CYDEV_PROJ_TYPE_MULTIAPPBOOTLOADER EQU 3
CYDEV_PROJ_TYPE_STANDARD EQU 0
CYDEV_PROTECTION_ENABLE EQU 0
CYDEV_STACK_SIZE EQU 0x4000
CYDEV_USE_BUNDLED_CMSIS EQU 1
CYDEV_VARIABLE_VDDA EQU 0
CYDEV_VDDA_MV EQU 5000
CYDEV_VDDD_MV EQU 5000
CYDEV_VDDIO0_MV EQU 5000
CYDEV_VDDIO1_MV EQU 5000
CYDEV_VDDIO2_MV EQU 5000
CYDEV_VDDIO3_MV EQU 5000
CYDEV_VIO0 EQU 5
CYDEV_VIO0_MV EQU 5000
CYDEV_VIO1 EQU 5
CYDEV_VIO1_MV EQU 5000
CYDEV_VIO2 EQU 5
CYDEV_VIO2_MV EQU 5000
CYDEV_VIO3 EQU 5
CYDEV_VIO3_MV EQU 5000
DMA_CHANNELS_USED__MASK0 EQU 0x00000000
CYDEV_BOOTLOADER_ENABLE EQU 0
    ENDIF
    END
